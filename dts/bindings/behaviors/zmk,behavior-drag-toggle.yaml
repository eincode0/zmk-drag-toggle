## dts/bindings/behaviors/zmk,behavior-drag-toggle.yaml
```yaml
description: Drag toggle behavior (single=click, double=lock press, press again=release)
compatible: "zmk,behavior-drag-toggle"
include: one_param.yaml
```
